/**
 * @cliArgs --board "/ti/boards/CC1352R1_LAUNCHXL" --rtos "tirtos" --product "simplelink_cc13xx_cc26xx_sdk@5.30.01.01"
 * @versions {"tool":"1.10.0+2163"}
 */

/**
 * Import the modules used in this configuration.
 */
const ble         = scripting.addModule("/ti/ble5stack/ble");
const CCFG        = scripting.addModule("/ti/devices/CCFG");
const rfdesign    = scripting.addModule("/ti/devices/radioconfig/rfdesign");
const Display     = scripting.addModule("/ti/display/Display");
const Display1    = Display.addInstance();
const AESCCM      = scripting.addModule("/ti/drivers/AESCCM");
const AESCCM1     = AESCCM.addInstance();
const AESCTRDRBG  = scripting.addModule("/ti/drivers/AESCTRDRBG");
const AESCTRDRBG1 = AESCTRDRBG.addInstance();
const AESECB      = scripting.addModule("/ti/drivers/AESECB");
const AESECB1     = AESECB.addInstance();
const ECDH        = scripting.addModule("/ti/drivers/ECDH");
const ECDH1       = ECDH.addInstance();
const NVS         = scripting.addModule("/ti/drivers/NVS");
const NVS1        = NVS.addInstance();
const NVS2        = NVS.addInstance();
const PIN         = scripting.addModule("/ti/drivers/PIN");
const PIN1        = PIN.addInstance();
const PIN2        = PIN.addInstance();
const PIN3        = PIN.addInstance();
const PIN4        = PIN.addInstance();
const Power       = scripting.addModule("/ti/drivers/Power");
const RF          = scripting.addModule("/ti/drivers/RF");
const RTOS        = scripting.addModule("/ti/drivers/RTOS");
const TRNG        = scripting.addModule("/ti/drivers/TRNG");
const TRNG1       = TRNG.addInstance();

/**
 * Write custom configuration values to the imported modules.
 */
ble.lockProject                                     = true;
ble.addressMode                                     = "ADDRMODE_PUBLIC";
ble.disableDisplayModule                            = true;
ble.uartLog                                         = true;
ble.maxPDUSize                                      = 251;
ble.maxConnNum                                      = 2;
ble.numOfAdvSets                                    = 1;
ble.numOfDefAdvSets                                 = 1;
ble.deviceName                                      = "SpiderPig";
ble.radioConfig.codeExportConfig.$name              = "ti_devices_radioconfig_code_export_param0";
ble.connUpdateParamsPeripheral.$name                = "ti_ble5stack_general_ble_conn_update_params0";
ble.connUpdateParamsPeripheral.reqConnTo            = 2000;
ble.connUpdateParamsPeripheral.reqMaxConnInt        = 45;
ble.connUpdateParamsPeripheral.reqMinConnInt        = 15;
ble.advSet1.$name                                   = "ti_ble5stack_broadcaster_advertisement_set0";
ble.advSet1.advParam1.$name                         = "ti_ble5stack_broadcaster_advertisement_params0";
ble.advSet1.advData1.$name                          = "ti_ble5stack_broadcaster_advertisement_data0";
ble.advSet1.advData1.GAP_ADTYPE_LOCAL_NAME_COMPLETE = true;
ble.advSet1.advData1.completeLocalName              = "SpiderPig";
ble.advSet1.scanRes1.$name                          = "ti_ble5stack_broadcaster_advertisement_data1";
ble.advSet1.scanRes1.GAP_ADTYPE_LOCAL_NAME_COMPLETE = true;
ble.advSet1.scanRes1.completeLocalName              = "SpiderPig";

CCFG.enableCodeGeneration = false;
CCFG.ccfgTemplate.$name   = "ti_devices_CCFGTemplateInit0";

rfdesign.fbSub1g = "none";

Display1.$name                                 = "CONFIG_Display_0";
Display1.$hardware                             = system.deviceData.board.components.XDS110UART;
Display1.enableANSI                            = true;
Display1.uartBufferSize                        = 128;
Display1.useUART2                              = false;
Display1.uart.$name                            = "CONFIG_DISPLAY_UART";
Display1.uart.txPinInstance.initialOutputState = "High";
Display1.uart.txPinInstance.$name              = "CONFIG_PIN_UART_TX";
Display1.uart.rxPinInstance.$name              = "CONFIG_PIN_UART_RX";

AESCCM1.$name = "CONFIG_AESCCM0";

AESCTRDRBG1.$name              = "CONFIG_AESCTRDRBG_0";
AESCTRDRBG1.aesctrObject.$name = "CONFIG_AESCTR_0";

AESECB1.$name = "CONFIG_AESECB0";

ECDH1.$name = "CONFIG_ECDH0";

NVS1.$name                    = "CONFIG_NVSINTERNAL";
NVS1.internalFlash.$name      = "ti_drivers_nvs_NVSCC26XX0";
NVS1.internalFlash.regionBase = 0x48000;
NVS1.internalFlash.regionSize = 0x4000;

NVS2.$hardware                      = system.deviceData.board.components.MX25R8035F;
NVS2.$name                          = "CONFIG_NVSEXTERNAL";
NVS2.externalFlash.$name            = "ti_drivers_nvs_NVSSPI25X0";
NVS2.externalFlash.verifyBufferSize = 64;

PIN1.$hardware = system.deviceData.board.components["BTN-1"];
PIN1.$name     = "CONFIG_GPIO_BTN1";

PIN2.$hardware = system.deviceData.board.components["BTN-2"];
PIN2.$name     = "CONFIG_GPIO_BTN2";

PIN3.$hardware = system.deviceData.board.components.LED_RED;
PIN3.mode      = "Output";
PIN3.$name     = "CONFIG_PIN_RLED";

PIN4.$hardware = system.deviceData.board.components.LED_GREEN;
PIN4.mode      = "Output";
PIN4.$name     = "CONFIG_PIN_GLED";

TRNG1.$name = "CONFIG_TRNG_0";

const NVSSPI25XDevice                         = scripting.addModule("/ti/drivers/nvs/NVSSPI25XDevice", {}, false);
const NVSSPI25XDevice1                        = NVSSPI25XDevice.addInstance({}, false);
NVSSPI25XDevice1.$name                        = "CONFIG_NVS_SPI_0";
NVS2.externalFlash.spiFlashDevice             = NVSSPI25XDevice1;
NVSSPI25XDevice1.slaveSelectPinInstance.$name = "CONFIG_GPIO_0";

const SPI                          = scripting.addModule("/ti/drivers/SPI", {}, false);
const SPI1                         = SPI.addInstance({}, false);
SPI1.$name                         = "CONFIG_SPI_0";
NVSSPI25XDevice1.sharedSpiInstance = SPI1;

/**
 * Pinmux solution for unlocked pins/peripherals. This ensures that minor changes to the automatic solver in a future
 * version of the tool will not impact the pinmux you originally saw.  These lines can be completely deleted in order to
 * re-solve from scratch.
 */
Display1.uart.uart.$suggestSolution           = "UART1";
Display1.uart.uart.txPin.$suggestSolution     = "boosterpack.4";
Display1.uart.uart.rxPin.$suggestSolution     = "boosterpack.3";
PIN1.pinPin.$suggestSolution                  = "boosterpack.13";
PIN2.pinPin.$suggestSolution                  = "boosterpack.12";
PIN3.pinPin.$suggestSolution                  = "boosterpack.39";
PIN4.pinPin.$suggestSolution                  = "boosterpack.40";
NVSSPI25XDevice1.slaveSelect.$suggestSolution = "boosterpack.38";
SPI1.spi.$suggestSolution                     = "SSI0";
SPI1.spi.sclkPin.$suggestSolution             = "boosterpack.7";
SPI1.spi.misoPin.$suggestSolution             = "boosterpack.14";
SPI1.spi.mosiPin.$suggestSolution             = "boosterpack.15";
SPI1.spi.dmaRxChannel.$suggestSolution        = "DMA_CH3";
SPI1.spi.dmaTxChannel.$suggestSolution        = "DMA_CH4";
